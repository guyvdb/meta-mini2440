## conf/layer.conf
```bitbake
 
# We have a conf and classes directory, add to BBPATH
BBPATH .= ":${LAYERDIR}"

# We have a packages directory, add to BBFILES
BBFILES += "${LAYERDIR}/recipes-*/*/*.bb"

BBFILE_COLLECTIONS += "mini2440"
BBFILE_PATTERN_mini2440 := "^${LAYERDIR}/"
BBFILE_PRIORITY_mini2440 = "1"
```

## conf/machine/mini2440.conf
```bitbake
#@TYPE: Machine
#@NAME: Mini2440
#@DESCRIPTION: Machine configuration for mini2440 SBC

LICENCE = "?"

require conf/machine/include/tune-arm920t.inc

KERNEL_IMAGETYPE = "uImage"
SERIAL_CONSOLE = "115200 ttySAC0"

MACHINE_FEATURES = " uboot touchscreen screen lcd rgb16"
MACHINE_FEATURES += "usbhost usbgadget"
MACHINE_FEATURES += "i2c spi"
MACHINE_FEATURES += "mmc mmcroot vfat"
MACHINE_FEATURES += "ethernet"
MACHINE_FEATURES += "sound alsa"

PREFERRED_PROVIDER_virtual/kernel = "linux-mini2440"

# are we going to use uboot or openbox?
#UBOOT_ENTRYPOINT = "30008000"
```
